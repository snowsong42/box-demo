## components/audio/Kconfig
```kconfig
menu "Audio Configuration"
    config AUDIO_I2S_NUM
        int "I2S port number"
        default 0
        range 0 1
        help
            I2S peripheral to use for audio output.
endmenu
```

## components/buttons/Kconfig
```kconfig
menu "Buttons Configuration"
    config BUTTONS_DEBOUNCE_MS
        int "Debounce time (ms)"
        default 0
        range 0 50
        help
            Button debounce delay. Set to 0 to use edge detection only.
endmenu
```

## components/display/Kconfig
```kconfig
menu "Display Configuration"
    config DISPLAY_BACKBUFFER_PSRAM
        bool "Use PSRAM for backbuffer"
        default y
        help
            Allocate the 320x240 backbuffer in PSRAM. Required for memory-intensive features.
endmenu
```

## components/net_test/Kconfig
```kconfig
menu "Network Configuration"
    config NETWORK_ENABLE
        bool "Enable Network component"
        default y
        help
            Enable WiFi provisioning and network test features.

    config NETWORK_DEFAULT_HOST
        string "Default ping/test host"
        default "baidu.com"
        help
            Default hostname for ping and connectivity tests.

    config NETWORK_PROV_AP_SSID
        string "Provisioning AP SSID"
        default "box-demo-config"
        help
            SSID of the SoftAP created for WiFi provisioning.

    config NETWORK_MAX_RESULT_LINES
        int "Max result text lines"
        default 80
        range 20 200
        help
            Maximum number of result text lines to buffer for scrollback.
endmenu
```

## components/storage/Kconfig
```kconfig
menu "Storage Configuration"
    config STORAGE_SPIFFS_PARTITION
        string "SPIFFS partition label"
        default "storage"
        help
            Partition label for SPIFFS mount point.
endmenu
```

## sdkconfig.defaults
```kconfig
# sdkconfig.defaults — box-demo 项目默认配置
# 目标芯片: ESP32-S3
CONFIG_IDF_TARGET_ESP32S3=y

# Flash 配置
CONFIG_ESPTOOLPY_FLASHMODE_DIO=y
CONFIG_ESPTOOLPY_FLASHSIZE_16MB=y

# 分区表
CONFIG_PARTITION_TABLE_CUSTOM=y
CONFIG_PARTITION_TABLE_CUSTOM_FILENAME="partitions.csv"

# SPIFFS
CONFIG_SPIFFS=y
CONFIG_SPIFFS_PART_SIZE=0x400000

# PSRAM
CONFIG_SPIRAM=y
CONFIG_SPIRAM_MODE_QUAD=y
CONFIG_SPIRAM_SPEED_80M=y

# 日志级别
CONFIG_LOG_DEFAULT_LEVEL_INFO=y

# FreeRTOS
CONFIG_FREERTOS_HZ=1000

# 编译优化 (Debug)
CONFIG_COMPILER_OPTIMIZATION_DEFAULT=y
```
